#include "ButtonGlyphs.h"

#include <cstring>

#include "../infra/BadgeConfig.h"
#include "../hardware/oled.h"
#include "OLEDLayout.h"

namespace ButtonGlyphs {
namespace {

// Kevin's 23x23 button-cluster map, reduced to the footer-safe 10x10
// size. Letter interiors are removed; the requested button is filled.
constexpr uint8_t kYBits[] = {
    0x30, 0x00,
    0x78, 0x00,
    0x78, 0x00,
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    0x30, 0x00,
};
constexpr uint8_t kBBits[] = {
    0x30, 0x00,
    0x48, 0x00,
    0x48, 0x00,
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    0x30, 0x00,
};
constexpr uint8_t kABits[] = {
    0x30, 0x00,
    0x48, 0x00,
    0x48, 0x00,
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    0x30, 0x00,
};
constexpr uint8_t kXBits[] = {
    0x30, 0x00,
    0x48, 0x00,
    0x48, 0x00,
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    0x30, 0x00,
};
// Pre-baked composite cluster glyphs — same 10×10 footprint as a single
// button, but with multiple pads filled. Generated by downsampling
// Kevin's 23×23 inverted reference PNGs (see assets/Allinv,
// LRinv, UDinv). They happen to be bit-identical to OR-ing the
// per-button glyphs above, which is what we want — using a single
// pre-baked draw call avoids the two-three drawXBM hops per glyph.
constexpr uint8_t kAllBits[] = {
    0x30, 0x00,
    0x78, 0x00,
    0x78, 0x00,
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    0x30, 0x00,
};
constexpr uint8_t kLRBits[] = {
    0x30, 0x00,
    0x48, 0x00,
    0x48, 0x00,
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    0x30, 0x00,
};
constexpr uint8_t kUDBits[] = {
    0x30, 0x00,
    0x78, 0x00,
    0x78, 0x00,
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    0x30, 0x00,
};
const uint8_t* bitsFor(Button button) {
  switch (button) {
    case Button::Y:
      return kYBits;
    case Button::B:
      return kBBits;
    case Button::A:
      return kABits;
    case Button::X:
      return kXBits;
    default:
      return kXBits;
  }
}

Button confirmButton() {
  return badgeConfig.get(kSwapConfirmCancel) != 0 ? Button::B : Button::A;
}

Button cancelButton() {
  return badgeConfig.get(kSwapConfirmCancel) != 0 ? Button::A : Button::B;
}

bool isSpace(char c) {
  return c == ' ' || c == '\t';
}

bool isBoundary(const char* text, size_t pos) {
  return pos == 0 || isSpace(text[pos - 1]);
}

bool tokenEnds(char c) {
  return c == '\0' || c == ':' || isSpace(c);
}

bool matchesWord(const char* text, const char* word, size_t len) {
  for (size_t i = 0; i < len; i++) {
    char a = text[i];
    char b = word[i];
    if (a >= 'a' && a <= 'z') a = static_cast<char>(a - 'a' + 'A');
    if (b >= 'a' && b <= 'z') b = static_cast<char>(b - 'a' + 'A');
    if (a != b) return false;
  }
  return true;
}

// Pre-baked composite glyphs (all 4, left+right, up+down). Returned
// via this enum so the inline parser can treat them as a single
// 10×10 draw rather than walking the OR helper.
enum class ClusterGlyph : uint8_t { kNone, kAll, kLR, kUD };

const uint8_t* clusterBits(ClusterGlyph c) {
  switch (c) {
    case ClusterGlyph::kAll: return kAllBits;
    case ClusterGlyph::kLR:  return kLRBits;
    case ClusterGlyph::kUD:  return kUDBits;
    default:                 return nullptr;
  }
}

// Recognises the three composite tokens. Returns true and writes
// `*cluster` + the consumed character count if matched. Acts before
// the per-button parser so `L/R`, `X/B`, `U/D`, `Y/A`, and `ALL`
// produce one glyph each instead of two side-by-side or the legacy
// OR-of-singles path.
bool clusterToken(const char* text, size_t pos, ClusterGlyph* cluster,
                  size_t* consumed) {
  if (!text || !isBoundary(text, pos)) return false;
  const char* s = text + pos;
  auto match = [&](const char* word, size_t len, ClusterGlyph c) -> bool {
    if (matchesWord(s, word, len) && tokenEnds(s[len])) {
      *cluster = c;
      *consumed = len + (s[len] == ':' ? 1u : 0u);
      return true;
    }
    return false;
  };
  if (match("ALL", 3, ClusterGlyph::kAll)) return true;
  if (match("L/R", 3, ClusterGlyph::kLR))  return true;
  if (match("X/B", 3, ClusterGlyph::kLR))  return true;
  if (match("U/D", 3, ClusterGlyph::kUD))  return true;
  if (match("Y/A", 3, ClusterGlyph::kUD))  return true;
  if (match("^v",  2, ClusterGlyph::kUD))  return true;
  return false;
}

bool buttonToken(const char* text, size_t pos, Button* button,
                 size_t* consumed, bool* hasPair, Button* pairButton) {
  if (!text || !isBoundary(text, pos)) return false;
  const char* s = text + pos;
  if (matchesWord(s, "CONFIRM", 7) && tokenEnds(s[7])) {
    *button = confirmButton();
    *consumed = 7;
    *hasPair = false;
  } else if (matchesWord(s, "OK", 2) && tokenEnds(s[2])) {
    *button = confirmButton();
    *consumed = 2;
    *hasPair = false;
  } else if (matchesWord(s, "CANCEL", 6) && tokenEnds(s[6])) {
    *button = cancelButton();
    *consumed = 6;
    *hasPair = false;
  } else if (matchesWord(s, "BACK", 4) && tokenEnds(s[4])) {
    *button = cancelButton();
    *consumed = 4;
    *hasPair = false;
  } else if (matchesWord(s, "UP", 2) && tokenEnds(s[2])) {
    *button = Button::Y;
    *consumed = 2;
    *hasPair = false;
  } else if (matchesWord(s, "DOWN", 4) && tokenEnds(s[4])) {
    *button = Button::A;
    *consumed = 4;
    *hasPair = false;
  } else if ((s[0] == 'Y' || s[0] == 'y') && tokenEnds(s[1])) {
    *button = Button::Y;
    *consumed = 1;
    *hasPair = false;
  } else if ((s[0] == 'B' || s[0] == 'b') && tokenEnds(s[1])) {
    *button = Button::B;
    *consumed = 1;
    *hasPair = false;
  } else if ((s[0] == 'A' || s[0] == 'a') && tokenEnds(s[1])) {
    *button = Button::A;
    *consumed = 1;
    *hasPair = false;
  } else if ((s[0] == 'X' || s[0] == 'x') && tokenEnds(s[1])) {
    *button = Button::X;
    *consumed = 1;
    *hasPair = false;
  } else if ((s[0] == '^' || s[0] == 'U' || s[0] == 'u') && tokenEnds(s[1])) {
    *button = Button::Y;
    *consumed = 1;
    *hasPair = false;
  } else if ((s[0] == 'v' || s[0] == 'V' || s[0] == 'D' || s[0] == 'd') &&
             tokenEnds(s[1])) {
    *button = Button::A;
    *consumed = 1;
    *hasPair = false;
  } else if ((s[0] == '<' || s[0] == 'L' || s[0] == 'l') && tokenEnds(s[1])) {
    *button = Button::X;
    *consumed = 1;
    *hasPair = false;
  } else if ((s[0] == '>' || s[0] == 'R' || s[0] == 'r') && tokenEnds(s[1])) {
    *button = Button::B;
    *consumed = 1;
    *hasPair = false;
  } else {
    return false;
  }

  if (s[*consumed] == ':') {
    (*consumed)++;
  }
  return true;
}

int drawOrMeasureInline(oled& d, int x, int baseline, const char* text,
                        bool draw) {
  if (!text) return 0;
  int cursor = x;
  const size_t len = std::strlen(text);

  // Scratch buffer for batching consecutive non-token characters into
  // a single drawStr call. Drawing chars one-at-a-time was visually
  // broken — u8g2's single-character `getStrWidth` returns the glyph
  // bbox without the inter-character advance for proportional fonts,
  // so adjacent letters mash together into an unreadable blob.
  // Sized to comfortably hold any realistic OLED status line.
  char buf[64];
  size_t bufLen = 0;
  auto flushBuf = [&]() {
    if (bufLen == 0) return;
    buf[bufLen] = '\0';
    if (draw) d.drawStr(cursor, baseline, buf);
    cursor += d.getStrWidth(buf);
    bufLen = 0;
  };

  for (size_t i = 0; i < len;) {
    // Composite cluster glyphs (ALL / L-R / U-D) take precedence over
    // the per-button parser since they share single-letter prefixes.
    ClusterGlyph cluster = ClusterGlyph::kNone;
    size_t consumed = 0;
    if (clusterToken(text, i, &cluster, &consumed)) {
      flushBuf();
      if (draw) {
        d.drawXBM(cursor, baseline - kGlyphH + 1, kGlyphW, kGlyphH,
                  clusterBits(cluster));
      }
      cursor += kGlyphW + kGap;
      i += consumed;
      continue;
    }

    Button button = Button::X;
    bool hasPair = false;        // unused now — kept for API stability
    Button pairButton = Button::B;
    if (buttonToken(text, i, &button, &consumed, &hasPair, &pairButton)) {
      flushBuf();
      if (draw) {
        ButtonGlyphs::draw(d, button, cursor, baseline - kGlyphH + 1);
      }
      cursor += kGlyphW + kGap;
      i += consumed;
      continue;
    }

    if (bufLen + 1 >= sizeof(buf)) flushBuf();
    buf[bufLen++] = text[i];
    i++;
  }
  flushBuf();
  return cursor - x;
}

}  // namespace

void draw(oled& d, Button button, int x, int y) {
  d.drawXBM(x, y, kGlyphW, kGlyphH, bitsFor(button));
}

// Footer chip labels render verbatim — callers control case. The
// previous version force-uppercased all hint labels, which made
// lower-case labels (used by the editor / files screens) inconsistent
// with the in-line glyph hints rendered elsewhere.

int measureHint(oled& d, Button button, const char* label) {
  (void)button;
  if (!label || !label[0]) return kGlyphW;
  return kGlyphW + kGap + d.getStrWidth(label);
}

int drawHint(oled& d, int x, int baseline, Button button, const char* label) {
  // The action-row rule (kFooterRuleY) sits on the glyph's top pixel
  // row by design — we knock out a 1-px gap on each side of the glyph
  // so the rule cleanly breaks at the chip rather than smearing into
  // the glyph outline. Only fires when this hint is being painted at
  // the action-row baseline; in-line hints elsewhere on the screen
  // shouldn't accidentally erase neighbouring pixels.
  const int glyphTop = baseline - kGlyphH + 1;
  if (glyphTop == OLEDLayout::kFooterRuleY) {
    d.setDrawColor(0);
    d.drawPixel(x - 1, glyphTop);
    d.drawPixel(x + kGlyphW, glyphTop);
    d.setDrawColor(1);
  }
  draw(d, button, x, glyphTop);
  int cursor = x + kGlyphW;
  if (label && label[0]) {
    cursor += kGap;
    d.drawStr(cursor, baseline, label);
    cursor += d.getStrWidth(label);
  }
  return cursor - x;
}

int measureInlineHint(oled& d, const char* text) {
  return drawOrMeasureInline(d, 0, 0, text, false);
}

int drawInlineHint(oled& d, int x, int baseline, const char* text) {
  return drawOrMeasureInline(d, x, baseline, text, true);
}

int drawInlineHintRight(oled& d, int rightX, int baseline, const char* text) {
  int w = measureInlineHint(d, text);
  drawInlineHint(d, rightX - w, baseline, text);
  return w;
}

int measureInlineHintCompact(oled& d, const char* text) {
  return measureInlineHint(d, text);
}

int drawInlineHintCompact(oled& d, int x, int baseline, const char* text) {
  return drawInlineHint(d, x, baseline, text);
}

}  // namespace ButtonGlyphs
