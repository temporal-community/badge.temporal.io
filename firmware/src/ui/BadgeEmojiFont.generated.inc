/*
  Fontname: -gnu-Unifont-Medium-R-Normal-Sans-16-160-75-75-c-80-iso10646-1
  Copyright: (null)
  Glyphs: 84/84
  BBX Build Mode: 1
*/
const uint8_t u8g2_font_badge_emoji[3259] U8G2_FONT_SECTION("u8g2_font_badge_emoji") =
  "T\1\3\2\5\5\1\2\6\20\20\0\376\0\0\0\0\4\365\11\247\14\236 ,\20\6>\313\240C\252"
  "\234Ca\16f\221&U\244$R\22%O\224(\217\222h\70EK\313\26)\211\24F\203\24\253:"
  "\64\350\14!*\20\6>[R\37\222\326,\251ha\322)Q\362$R\362$\315\223\70\215\362,\314"
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  "\317\222\34\322\242\70Z\242\64\213\305(\211rD\213r$\214r\64\4;%\20\6>\347!\33\302a"
  "\31\246\341\313\360e\370\64<d\303C\70\34\344\341\216\14C\216\15:\272\343\71\33\0<!\20\6>"
  "\257\212\216\15C\16\15C\216\15:\272\343\71b\307\206!\207\206!\307\6\35\335\361\234\17=#\20\6"
  ">\367m\36\224A\34.\333\62d\266!\31\225C:h\363\240\354\310\60\344\330\240\243;\236\363\12>"
  "(\20\6>\367m\36\224A\34\226a\33\206d\320\206!\31\304A\31\324A\31\344A\331\221!\321\61"
  "EG\223\34\317y\5\77 \20\6>\377%\307\225\34\35rp\330\221dX\342!\31\344A\31\342!"
  "\32rQ\207\354<\1@%\20\6>=\247\344x\222\243Y\16\251:\224\325\221b\16\205I\216D\232"
  "\16&\71\236\203Y\216%\71\236\263\1A\42\20\6>SN\311\361$\207\223\34\31\264A\314\241\70\317"
  "\221\64\307\352X\232#Y\71R\244\364\316\3B \20\6>\377=\307\223\34\215r\60\12\343(L\302"
  "(M\262(OJ\71\22\325\261:\272\63\2C#\20\6>wU\36\262!\36\222!G\206!\307\6"
  "\35\34tl\30rdH\206x\310\206\364\234\347\374\6D\30\20\6>\377\357\353\230\65%R\222HI"
  "\42%\211Tk\134w\376\21E\34\20\6>\377\227A\307\242aHs,R\207\35\314a\235\222#\232"
  "\16\16\71\317\0F&\20\6>\71\313\301,\307\322\34\212s$\317\345\34\251\351\220\222\350\240\242\243I"
  "\16'\71\234\344p\222\343\71\13\0G\32\20\6>\377\247A\37\206(\315\261tX\365\234\244\343\71I"
  "\323\261!\347\1H'\20\6>\313\240C\252\234Ca\16f\221&\325lI\16'\71\234D\303\251\322"
  "\267HI\244\60\32\244X\325\241AgI#\20\6>\313\240C\252\234Ca\16f\221&\325lI\16"
  "'\71\234\344p\224u\34\353P\254\352\320\240\63J$\20\6>\223\16\17\71:\344\260\316e\310\265!"
  "\23\223a\311\207A\307\206\34\35rt\310\321!G\207\234\5K)\20\6>\313\240C\252\234Ca\16"
  "f\321\62\25%-\311\341$\207\223LG\242Pi\213\223\266\64i\324\322x\321r\64\12L&\20\6"
  ">\313\240C\252\234Ca\16f\221&\25kI\16'\71\234\344XTG\242,\335\302\34\212U\35\32"
  "t\6M+\20\6\356\240C\252\234Ca\244IY\22%Q\22\345p\222\303I\224\224\223\236JJe"
  "\312\324\260&\246Q\250C\203\16\346\254\0N)\20\6>\313\240C\252\234Ca\244IY\242$J)"
  "\32\222!J\62[\222\303I\16G\341\230\345`\35\212U\35\32t\6O'\20\6>\313\240C\252\234"
  "Ca\244IY\22%Q\22\265D\225\314\226\344p\222\303Q\70f\35s(Vuh\320\31P)\20"
  "\6>\313\240C\252\234Ca\16f\221\36e\266$G\264$\207\23)\207jC\230\350\260&N\311\224"
  "E\273\224\303#\0Q*\20\6>\313\240C\252\234\310a\22\325*JSM\13\223\34N\242\341\224D"
  "I\247\222\222HY\66ha\16\305\252\16\15:\3R(\20\6>\313\240C\252\34eQ\30\245Q\26"
  "iR\315\226\344p\222\303I\64\234J\303\20eyR\214\23Y\325\241AgS'\20\6>\313\240C"
  "\252\234Ca\16f\221&u\211*\71\234\344p\22\345Qk\224e\203\26fQYRth\320\31T"
  ")\20\6>\313\240C\252\234Ca\216DY\244\225\62\61Kr\70\311\341$\207\243h\30\242,\214\262"
  "\60\324bU\207\6\235\1U'\20\6>\313\240C\252\234Ca\224FY\247,\315\222\34Nr\70\311"
  "\341(\32\206(\13\243,\14\265X\325\241AgV%\20\6>\313\220c\242\236#i\216\205\71V:"
  "\325\321(G\243\34\252\345Q\230ji\216\344\242\216\15\71\13\0W(\20\6>\313\240C\252\234Ca"
  "\16f\221&\325lI\16'\341 &\231\222hQ\322\267d\270\204\71\24\253:\64\350\14X'\20\6"
  ">\313\240C\252\234Ca\16fI\224DI\224\331\222\34Nr\70\311\341(\33\264:X\207bU\207"
  "\6\235\1Y*\20\6>\313\240C\252\234Ca\16fI\224DI\224\331\222\34\213\222\34\213\222\34\216"
  "\262A+\245Q\230C\261\252C\203\316\0Z&\20\6>\313\240C\252\234Ca\16f\235\262\64Kr"
  "\60\251\203I\35\216\262A+\245Q\230C\261\252C\203\316\0['\20\6>\313\240C\252\34eQ\30"
  "\245Q\26iR\315\226\344p\222\303I\16G\331\240\225\322(\314\241X\325\241Ag\134+\20\6>\313"
  "\240C\252\34eQ\30\245Q\26&a\24fa\222\303I\70\210I\226fQ\222'Y\62\134\302\34\212"
  "U\35\32t\6]&\20\6>\313\240C\252\234\244I\230u\322\244\232-\311\341$\207\223p\20\243j"
  "\224\205c)\213bU\207\6\235\1^&\20\6>\313\240C\252\234\244I\230u\322\244\232-\311\341$"
  "\207\223\34\216\262A+\245Q\230C\261\252C\203\316\0_'\20\6>\313\240C\252\234Ca\16f\321"
  "\62\25%-\311\341$\207\223\34\216\242a\210\262\34\254C\261\252C\203\316\0`&\20\6>\313\240C"
  "\252\234Ca\16f\71\30e\313\226\344p\222\303I\16G\321\60DY\16\326\241X\325\241Aga+"
  "\20\6>\313\240C\252\234Ca\326)\215*\311\245\242\344\211\322\232T\224hJ$%Y\22-\211\246"
  "$L\322$Vuh\320\31b.\20\6>\313\240C\252\34eQ\30\245Q\26iR\315\226\344p\262"
  "CK\24M\225(\232Z\242)\311\242\64\312\242\64\312\242a\210r\32\0c&\20\6>\313\240C\252"
  "\34eQ\30\245Q\26iR\315\226\344`R\7\223\352\32\205c\26\216u(Vuh\320\31d*\20"
  "\6>\313\240C\252\234Ca\24fMa\224Ib\222Ib\222\303I\226,YTY\242,\34+i"
  "\22\347\71\62\14\71\31e)\20\6>\313\240C\252\234Ca\16fI\224DI\224\331\222\34Nrd"
  "Jr,*J\265PY\302\34\212U\35\32t\6f.\20\6>O\203\256\14C\42E\312\42%Q"
  "VJ*\232R\232\222h\224\222H\215\262(M\222\245\30\245Q\226$\203RK\242)\311\71\3g+"
  "\20\6>O\203\256\14C\42E\312\42%QVJ\352P\22IY$\346P\34M\71\242\351H\232\304"
  "\321 \205Q\262D\71g\0h*\20\6>}\320!U\316\241\64\207\302H\223\262dH\206$K\206"
  "dH\262H\223\302\34Js(\36\356Hwh\30r\236\0i\36\20\6>\317:\236\344pN\311q"
  "I\207\246$\225\262<I\363XOg\71\336\361\234\3j\37\20\6>\377\64\34rR\216\17:\226\343"
  "\71%\233\326%\235*i\42\325\225H\207\6\235\5k'\20\6>=\312\301D\311\261D\311\261$\312"
  "\261\244\16FC\216,\355I\367\244{\35Is(\315\261:\230\345,\0l!\20\6>/\71\236\204"
  "\71RK\362$K\362\304\222'\335\223\356\315\71\24\346X\230c\303\316\33\0m \20\6>\317:*"
  "\345\220\246#\231>D:)\207uR>D:\232\345\250\224\303Q\16\353\14n.\20\6>U\207\243"
  "\34\215r\60\312\321$\32\362\244\30'r\232\344H\230D\215I\216\204I\64Da\24Ii\26&i"
  "\66da\216E\0o-\20\6>uH\206\70lZ\246\366()\15R\322\65i\321\225\246,J\332"
  "\241\244\35J\232\6))ES%K\263(\33\264:\30\1p+\20\6>\313\220c\242\236#i\216"
  "\205\221)\313$-\312\321(G\243hT\62m\210\302d\10\325tH\243a\312\242\70\312i\0q!"
  "\20\6>\65\253#Q\235u\320\261\64G\362\212%W\345$\252\204YS\64\234\222\270\62|\347\12r"
  ",\20\6>\313\240C\252\34eQ\30\245Q\26-S%\207\222R\36%\322\60DJkRJT%"
  "\213\206!\12s(Vuh\320\31s(\20\6>\313\240C\252\234Ca\16f\221&u\211*\71\234"
  "\344p\22\15\247J\236dQ\32\205\321 \305\252\16\15:\3\0\0\0\4\377\377\0";
